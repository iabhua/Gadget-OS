## gadget/Config.in
```kconfig
source "$BR2_EXTERNAL_GADGETOS_PATH/package/demo-blinkenlights/Config.in"
source "$BR2_EXTERNAL_GADGETOS_PATH/package/demo-vu-meter/Config.in"
source "$BR2_EXTERNAL_GADGETOS_PATH/package/gadget-bluetooth-conf/Config.in"
source "$BR2_EXTERNAL_GADGETOS_PATH/package/gadget-initc/Config.in"
source "$BR2_EXTERNAL_GADGETOS_PATH/package/gadget-init-scripts/Config.in"
source "$BR2_EXTERNAL_GADGETOS_PATH/package/gadget-setup-ssh-key/Config.in"
source "$BR2_EXTERNAL_GADGETOS_PATH/package/gadget-tools/Config.in"
source "$BR2_EXTERNAL_GADGETOS_PATH/package/dtc-overlay/Config.in.host"
source "$BR2_EXTERNAL_GADGETOS_PATH/package/rtl8723bs_mp_driver/Config.in"
source "$BR2_EXTERNAL_GADGETOS_PATH/package/rtl8723ds_mp_driver/Config.in"
source "$BR2_EXTERNAL_GADGETOS_PATH/package/rtl8723ds_bt/Config.in"
source "$BR2_EXTERNAL_GADGETOS_PATH/package/python-chip-io/Config.in"
source "$BR2_EXTERNAL_GADGETOS_PATH/package/eth_usb_gadget/Config.in"
source "$BR2_EXTERNAL_GADGETOS_PATH/package/network-interfaces-script/Config.in.host"
source "$BR2_EXTERNAL_GADGETOS_PATH/package/chip-mtd-utils/Config.in"
source "$BR2_EXTERNAL_GADGETOS_PATH/package/chip-mtd-utils/Config.in.host"
source "$BR2_EXTERNAL_GADGETOS_PATH/package/mender/Config.in"
source "$BR2_EXTERNAL_GADGETOS_PATH/package/gadget-update/Config.in"
source "$BR2_EXTERNAL_GADGETOS_PATH/package/chip-nand-scripts/Config.in.host"
source "$BR2_EXTERNAL_GADGETOS_PATH/package/wifi-onboarding/Config.in"
source "$BR2_EXTERNAL_GADGETOS_PATH/package/python-pip/Config.in"
source "$BR2_EXTERNAL_GADGETOS_PATH/package/direwolf/Config.in"
source "$BR2_EXTERNAL_GADGETOS_PATH/package/python-aprs/Config.in"
source "$BR2_EXTERNAL_GADGETOS_PATH/package/python-kiss/Config.in"
source "$BR2_EXTERNAL_GADGETOS_PATH/package/python-httpretty/Config.in"
source "$BR2_EXTERNAL_GADGETOS_PATH/package/python-nose/Config.in"
source "$BR2_EXTERNAL_GADGETOS_PATH/package/python-coverage/Config.in"
source "$BR2_EXTERNAL_GADGETOS_PATH/package/python-dummyserial/Config.in"
```

## gadget/package/direwolf/Config.in
```kconfig
config BR2_PACKAGE_DIREWOLF
	bool "direwolf"
	select BR2_PACKAGE_LIBASOUND
  select BR2_PTHREADS
	default n
	help
    Adds the Dire Wolf APRS AX.25 packet modem
```

## gadget/package/python-aprs/Config.in
```kconfig
config BR2_PACKAGE_PYTHON_APRS
	bool "python-aprs"
    select BR2_PACKAGE_PYTHON_NOSE
    select BR2_PACKAGE_PYTHON_COVERAGE
    select BR2_PACKAGE_PYTHON_HTTPRETTY
    select BR2_PACKAGE_PYTHON_DUMMYSERIAL
	default n
	help
    python aprs
```

## gadget/package/python-coverage/Config.in
```kconfig
config BR2_PACKAGE_PYTHON_COVERAGE
	bool "python-coverage"
	default n
	help
    python coverage
```

## gadget/package/python-dummyserial/Config.in
```kconfig
config BR2_PACKAGE_PYTHON_DUMMYSERIAL
	bool "python-dummyserial"
	default n
	help
    python dummyserial
```

## gadget/package/python-flup-102/Config.in
```kconfig
config BR2_PACKAGE_PYTHON_FLUP_102
	bool "python-flup-1.0.2"
	default n
	help
    python flup version 1.0.2
```

## gadget/package/python-gps3/Config.in
```kconfig
config BR2_PACKAGE_PYTHON_GPS3
	bool "python-gps3"
	default n
	help
    python gps3
```

## gadget/package/python-httpretty/Config.in
```kconfig
config BR2_PACKAGE_PYTHON_HTTPRETTY
	bool "python-httpretty"
	default n
	help
    python httpretty
```

## gadget/package/python-kiss/Config.in
```kconfig
config BR2_PACKAGE_PYTHON_KISS
	bool "python-kiss"
	default n
	help
    python kiss
```

## gadget/package/python-nose/Config.in
```kconfig
config BR2_PACKAGE_PYTHON_NOSE
	bool "python-nose"
	default n
	help
    python nose
```
